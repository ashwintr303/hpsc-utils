/ {
    cpus {
        rtps_r52_cpus {
            rtps_r52_cpu@0 {
                /* Load address of U-boot in RTPS DRAM */
                arm,rvbar = <0x40000000>;
                arm,vbar  = <0x40000000>;
            };
        };
    };
};
