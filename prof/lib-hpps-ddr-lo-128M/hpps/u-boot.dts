/ {
	memory {
		reg = /* Segments base:size (commented regions are used but available as
			   * general-purpose to U-boot/Linux): */

		/* DDR Low:    128 MiB = 0x08000000 */

		/* <0x00 0x80000000 0x00 0x00200000> ATF */
		/* <0x00 0x80020000 0x00 0x001e0000> padding to align for Linux; bins */
		   <0x00 0x80200000 0x00 0x07000000> /* mem for U-boot/Linux; bins */
		/* <0x00 0x87200000 0x00 0x00400000> ramoops */
		/* <0x00 0x87600000 0x00 0x00800000> inter-subsystem shmem regions */
		/* <0x00 0x87e00000 0x00 0x00200000> TRCH reservations (MMU PTs, etc) */
		;
	};
};
