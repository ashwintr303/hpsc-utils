## conf/base/hpps/linux/yocto/conf/local.conf
```bitbake
MACHINE = "hpsc-chiplet"
IMAGE_FSTYPES_append = " tar.gz"

EXTRA_IMAGEDEPENDS = ""
HPSC_IMAGE_INSTALL = ""

# unlocks root account (by setting blank passwd)
EXTRA_IMAGE_FEATURES = "debug-tweaks"
```

## conf/hpps-linux/hpps/linux/yocto/conf/local.conf
```bitbake
MACHINE = "hpsc-chiplet"
IMAGE_FSTYPES_append = " tar.gz"

EXTRA_IMAGEDEPENDS = ""

# unlocks root account (by setting blank passwd)
EXTRA_IMAGE_FEATURES = "debug-tweaks"

HPSC_IMAGE_INSTALL = "openssh"
```
